// old gateway overlay (single uart)
// #include "../boards/Ble_gateway_230426.overlay"
// new gateway overlay (sigle  uart)
// #include "../boards/Ble_gateway_070326_old.overlay"
// new gateway overlay (dual uart)
#include "../boards/Ble_gateway_070326_new.overlay"

